## src/kern/arm/bsp/gen/Kconfig
```kconfig
# PF: ARM_GEN
# PFDESCR: Generic Platform
# PFSELECT: CAN_ARM_CPU_V7A CAN_ARM_CPU_V8A
# PFSELECT: ARM_GIC
# PFSELECT: HAVE_ARM_GICV2
# PFSELECT: HAVE_ARM_GICV3
# PFSELECT: HAVE_ARM_GIC_MSI
# PFSELECT: ARM_GIC_MSI
# PFSELECT: HAVE_GIC_ESPI
# PFSELECT: ARM_PSCI HAS_ARM_PSCI HAS_ARM_PSCI_DYNAMIC
# PFSELECT: HAS_ARM_SVE
# PFSELECTIF: ARM_ASID16 if ARM_V8 && BIT64
# PFSELECT: ARM_IOMMU_COHERENT
# PFSELECT: HAS_DT_OPTION
# PFSELECTIF: DT if !ARM_ACPI
# PFDEPENDS: ARM

config PF_ARM_GEN_SELECT_SUPPORT
	bool "Generic platform: Select specific support"
	depends on EXPERT
	help
	  Configure specific hardware support for the generic platform.
	  On default, all support is available.
	
	  Select n if unsure.

config PF_ARM_GEN_SELECT_ACPI
	bool "Support ACPI" if PF_ARM_GEN_SELECT_SUPPORT
	default y
	select ARM_ACPI

config PF_ARM_GEN_SELECT_SMMU_V3
	bool "Support SMMUv3" if PF_ARM_GEN_SELECT_SUPPORT
	default y
	select HAS_IOMMU_ARM_SMMU_V3

config ARM_IOMMU_MAX
	int "Maximum number of supported IOMMUs" \
	  if PF_ARM_GEN_SELECT_SUPPORT && HAS_IOMMU_ARM_SMMU_V3
	depends on IOMMU
	default 32
	help
	  The size of some IOMMU-related data structures depend on the number
	  of supported IOMMUs. Setting the value too high increases the memory
	  allocation overhead. However, a value that is too low prevents the
	  kernel from booting.

	  If in doubt, leave the default (32).

config PF_ARM_GEN_SELECT_UART_PL011
	bool "Support UART pl011" if PF_ARM_GEN_SELECT_SUPPORT
	default y

config PF_ARM_GEN_SELECT_UART_16550
	bool "Support UART 16550" if PF_ARM_GEN_SELECT_SUPPORT
	default y

config PF_ARM_GEN_SELECT_UART_CADENCE
	bool "Support UART cadence" if PF_ARM_GEN_SELECT_SUPPORT
	default y

config PF_ARM_GEN_SELECT_UART_LINFLEX
	bool "Support UART linflex" if PF_ARM_GEN_SELECT_SUPPORT
	default y

config PF_ARM_GEN_SELECT_UART_SH
	bool "Support UART sh" if PF_ARM_GEN_SELECT_SUPPORT
	default y

config PF_ARM_GEN_SELECT_UART_DCC
	bool "Support UART DCC" if PF_ARM_GEN_SELECT_SUPPORT
	default y

config PF_ARM_GEN_SELECT_UART_IMX
	bool "Support UART i.MX" if PF_ARM_GEN_SELECT_SUPPORT
	default y

config PF_ARM_GEN_SELECT_UART_LPUART
	bool "Support UART lpuart" if PF_ARM_GEN_SELECT_SUPPORT
	default y

config PF_ARM_GEN_SELECT_UART_GENI
	bool "Support UART geni" if PF_ARM_GEN_SELECT_SUPPORT
	default y

config PF_ARM_GEN_SELECT_UART_DM
	bool "Support UART dm" if PF_ARM_GEN_SELECT_SUPPORT
	default y

config PF_ARM_GEN_SELECT_UART_OMAP
	bool "Support UART TI/OMAP" if PF_ARM_GEN_SELECT_SUPPORT
	default y

config PF_ARM_GEN_SELECT_UART_MVEBU
	bool "Support UART mvebu" if PF_ARM_GEN_SELECT_SUPPORT
	default y

config PF_ARM_GEN_SELECT_UART_STM32
	bool "Support UART stm32" if PF_ARM_GEN_SELECT_SUPPORT
	default y

config PF_ARM_GEN_SELECT_UART_TEGRA_TCU
	bool "Support UART tegra-tcu" if PF_ARM_GEN_SELECT_SUPPORT
	default y
```
